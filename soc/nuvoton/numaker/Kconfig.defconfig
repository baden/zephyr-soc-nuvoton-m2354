## soc/nuvoton/numaker/Kconfig.defconfig
```kconfig
# Copyright (c) 2023 Nuvoton Technology Corporation.
#
# SPDX-License-Identifier: Apache-2.0

rsource "*/Kconfig.defconfig.series"

if SOC_FAMILY_NUMAKER

config RESET
	default y

# DT
DT_SYSCLK_PATH := $(dt_nodelabel_path,sysclk)

config SYS_CLOCK_HW_CYCLES_PER_SEC
	default $(dt_node_int_prop_int,$(DT_SYSCLK_PATH),clock-frequency) if CORTEX_M_SYSTICK

endif
```

## soc/nuvoton/numaker/m2354/Kconfig.series
```kconfig
# Copyright (c) 2023 Nuvoton Technology Corporation.
#
# SPDX-License-Identifier: Apache-2.0

config SOC_SERIES_M2354
	bool "Nuvoton M2354 Series MCU"
	select ARM
	select CPU_CORTEX_M23
	# select CPU_CORTEX_M_HAS_DWT
	# #select CPU_HAS_FPU
	select CPU_CORTEX_M_HAS_VTOR
	select CPU_HAS_ARM_SAU
	select CPU_HAS_ARM_MPU
	select CORTEX_M_SYSTICK if SYS_CLOCK_EXISTS
	select CPU_CORTEX_M_HAS_SPLIM
	select CPU_CORTEX_M_HAS_SYSTICK
	# select CORTEX_M_SYSTICK_INSTALL_ISR
	select SOC_FAMILY_NUMAKER
	
	# select HAS_NUMAKER_GPIO
	# select HAS_NUMAKER_FMC

	# select SOC_FLASH_NUMAKER2

	help
	  Enable support for Nuvoton M2354 MCU series
```

## soc/nuvoton/numaker/m2354/Kconfig.soc
```kconfig
# Copyright (c) 2023 Nuvoton Technology Corporation.
#
# SPDX-License-Identifier: Apache-2.0

choice
	prompt "Nuvoton M2354 MCU Selection"
	depends on SOC_SERIES_M2354

config SOC_M2354
	bool "M2354"
	select HAS_NUMAKER_HAL
	# select PLATFORM_SPECIFIC_INIT
	select SOC_RESET_HOOK
	select SOC_EARLY_INIT_HOOK

endchoice
```
