## drivers/Kconfig
```kconfig
# Copyright (c) 2021 Nordic Semiconductor ASA
# SPDX-License-Identifier: Apache-2.0

#menu "Drivers"
rsource "clock_control/Kconfig"
rsource "sensor/Kconfig"
rsource "flash/Kconfig"
rsource "gpio/Kconfig"
rsource "pinctrl/Kconfig"
rsource "serial/Kconfig"
rsource "spi/Kconfig"
rsource "i2c/Kconfig"
rsource "reset/Kconfig"
rsource "pwm/Kconfig"
rsource "can/Kconfig"
rsource "adc/Kconfig"
rsource "input/Kconfig"


config HAS_NUMAKER_TIMER
    bool
    default y

#endmenu
```

## drivers/adc/Kconfig
```kconfig
# ADC configuration options

# Copyright (c) 2015 Intel Corporation
# SPDX-License-Identifier: Apache-2.0

#
# ADC options
#
# menuconfig ADC
# 	bool "Analog-to-Digital Converter (ADC) drivers"
# 	# All platforms that implement the ADC driver are now required to
# 	# provide relevant DTS entries.
# 	help
# 	  Enable ADC (Analog to Digital Converter) driver configuration.

if ADC

module = ADC
module-str = ADC
source "subsys/logging/Kconfig.template.log_config"

rsource "Kconfig.numaker"

endif # ADC
```

## drivers/can/Kconfig
```kconfig
# CAN configuration options

# Copyright (c) 2018 Alexander Wachter
# SPDX-License-Identifier: Apache-2.0

#
# CAN options
#

if CAN

module = CAN
module-str = CAN
source "subsys/logging/Kconfig.template.log_config"

rsource "Kconfig.numaker"

endif # CAN
```

## drivers/can/Kconfig.numaker
```kconfig
# NuMaker CAN(-FD) driver configuration options

# Copyright (c) 2023 Nuvoton Technology Corporation
# SPDX-License-Identifier: Apache-2.0

config CAN_NUMAKER2
	bool "Nuvoton NuMaker CAN driver"
	default y
	select CAN_MCAN
	depends on DT_HAS_NUVOTON_NUMAKER2_CAN_ENABLED
	depends on SOC_SERIES_M2354
	help
	  Enables Nuvoton NuMaker CAN FD driver, using Bosch M_CAN
```

## drivers/clock_control/Kconfig
```kconfig
# Clock controller driver configuration options

# Copyright (c) 2015 Intel Corporation
# SPDX-License-Identifier: Apache-2.0

#
# Clock controller drivers
#

if CLOCK_CONTROL

module = CLOCK_CONTROL
module-str = clock control
source "subsys/logging/Kconfig.template.log_config"

rsource "Kconfig.numaker"

endif # CLOCK_CONTROL
```

## drivers/flash/Kconfig
```kconfig
# Flash driver configuration options

# Copyright (c) 2016 Intel Corporation
# SPDX-License-Identifier: Apache-2.0

#
# Flash driver
#

menuconfig FLASH
	bool "Flash drivers"
	help
	  Enable support for the flash hardware.

if FLASH

module = FLASH
module-str = flash
source "subsys/logging/Kconfig.template.log_config"

rsource "Kconfig.numaker"

endif # FLASH
```

## drivers/flash/Kconfig.numaker
```kconfig
# NUMAKER GPIO driver configuration options

# Copyright (c) 2023 Nuvoton Technology Corporation.
# SPDX-License-Identifier: Apache-2.0

config SOC_FLASH_NUMAKER2
	bool "Nuvoton NuMaker MCU flash driver"
	default y
	select FLASH_HAS_PAGE_LAYOUT
	select FLASH_HAS_DRIVER_ENABLED
	select FLASH_HAS_EXPLICIT_ERASE
	select MPU_ALLOW_FLASH_WRITE if ARM_MPU
	select HAS_NUMAKER_FMC
	depends on DT_HAS_NUVOTON_NUMAKER2_FMC_ENABLED
	help
	  This option enables the FMC driver for Nuvoton NuMaker family of
	  processors.
	  Say y if you wish to enable NuMaker FMC.
```

## drivers/gpio/Kconfig
```kconfig
# GPIO configuration options

# Copyright (c) 2015 Intel Corporation
# SPDX-License-Identifier: Apache-2.0

# menuconfig GPIO
# 	bool "General-Purpose Input/Output (GPIO) drivers"
# 	help
# 	  Include GPIO drivers in system config

if GPIO

# module = GPIO
# module-str = gpio
# #source "subsys/logging/Kconfig.template.log_config"


rsource "Kconfig.numaker"

endif # GPIO
```

## drivers/i2c/Kconfig
```kconfig
# I2C configuration options

# Copyright (c) 2015 Intel Corporation
# SPDX-License-Identifier: Apache-2.0

#
# I2C options
#

if I2C

module = I2C
module-str = i2c
#source "subsys/logging/Kconfig.template.log_config"

rsource "Kconfig.numaker"

endif # I2C
```

## drivers/input/Kconfig
```kconfig
if INPUT

menu "Input drivers"

rsource "Kconfig.analog"


config POST_INPUT_INIT_PRIORITY
    int "Must be greater then INPUT_INIT_PRIORITY by 1"
    default 91


endmenu

endif # INPUT
```

## drivers/input/Kconfig.analog
```kconfig
config INPUT_ANALOG
	bool "ADC based analog input driver"
	default y
	depends on MULTITHREADING
	select ADC
	help
	  ADC based analog input driver

if INPUT_ANALOG

config INPUT_ANALOG_THREAD_STACK_SIZE
	int "Stack size for the analog input thread"
	# default 762
	default 2048
	help
	  Size of the stack used for the analog thread.

config INPUT_ANALOG_THREAD_PRIORITY
	int "Priority for the analog input thread"
	default 0
	help
	  Priority level of the analog thread.

endif
```

## drivers/pinctrl/Kconfig
```kconfig
# Copyright (c) 2021 Nordic Semiconductor ASA
# SPDX-License-Identifier: Apache-2.0

menuconfig PINCTRL
	bool "Pin controller drivers"

if PINCTRL

module = PINCTRL
module-str = PINCTRL
# source "subsys/logging/Kconfig.template.log_config"

rsource "Kconfig.numaker"

endif # PINCTRL
```

## drivers/pwm/Kconfig
```kconfig
# PWM configuration options

# Copyright (c) 2015 Intel Corporation
# SPDX-License-Identifier: Apache-2.0

if PWM

module = PWM
module-str = pwm
# source "subsys/logging/Kconfig.template.log_config"

rsource "Kconfig.numaker"

endif # PWM
```

## drivers/pwm/Kconfig.numaker
```kconfig
# NUMAKER PWM Driver configuration options

# Copyright (c) 2023 Nuvoton Technology Corporation.
# SPDX-License-Identifier: Apache-2.0

config PWM_NUMAKER2
	bool "Nuvoton NuMaker MCU PWM driver"
	default y
	select HAS_NUMAKER_PWM
	depends on DT_HAS_NUVOTON_NUMAKER2_PWM_ENABLED
	help
	  This option enables the PWM driver for Nuvoton NuMaker family of
	  processors.
	  Say y if you wish to enable NuMaker PWM.
```

## drivers/reset/Kconfig
```kconfig
# Reset Controller driver configuration options

# Copyright (c) 2022 Andrei-Edward Popa <andrei.popa105@yahoo.com>
# SPDX-License-Identifier: Apache-2.0

#
# Reset Controller options
#

if RESET


comment "Reset Controller Drivers"

rsource "Kconfig.numaker"

endif # RESET
```

## drivers/reset/Kconfig.numaker
```kconfig
# Nuvoton NuMaker Reset Controller configuration options

# Copyright (c) 2023 Nuvoton Technology Corporation.
# SPDX-License-Identifier: Apache-2.0

config RESET_NUMAKER2
	bool "Nuvoton NuMaker reset controller driver"
	default y
	depends on DT_HAS_NUVOTON_NUMAKER2_RST_ENABLED
	help
	  This option enables the reset controller driver for Nuvoton NuMaker MCUs.
```

## drivers/serial/Kconfig
```kconfig
# Serial driver configuration options

# Copyright (c) 2014-2015 Wind River Systems, Inc.
# SPDX-License-Identifier: Apache-2.0

if SERIAL

module = UART
module-str = uart

comment "Serial Drivers"

rsource "Kconfig.numaker"

endif # SERIAL
```

## drivers/serial/Kconfig.numaker
```kconfig
# NPCX UART driver configuration options

# Copyright (c) 2023 Nuvoton Technology Corporation.
# SPDX-License-Identifier: Apache-2.0

config UART_NUMAKER2
	bool "Nuvoton NUMAKER MCU serial driver"
	default y
	select SERIAL_HAS_DRIVER
	select HAS_NUMAKER_UART
	select SERIAL_SUPPORT_INTERRUPT
	depends on DT_HAS_NUVOTON_NUMAKER2_UART_ENABLED
	help
	  This option enables the UART driver for Nuvoton Numaker family of
	  processors.
	  Say y if you wish to use serial port on Nuvoton Numaker MCU.
```

## drivers/spi/Kconfig
```kconfig
# SPI driver configuration options

# Copyright (c) 2015-2016 Intel Corporation
# SPDX-License-Identifier: Apache-2.0

#
# SPI Drivers
#

if SPI

module = SPI
module-str = spi
# source "subsys/logging/Kconfig.template.log_config"

rsource "Kconfig.numaker"

endif # SPI
```

## dts/bindings/adc/nuvoton,numaker2-adc.yaml
```yaml
# Copyright (c) 2023 Nuvoton Technology Corporation.
# SPDX-License-Identifier: Apache-2.0

description: Nuvoton, NuMaker ADC controller

compatible: "nuvoton,numaker2-adc"

include: [adc-controller.yaml, reset-device.yaml, pinctrl-device.yaml]

properties:
  reg:
    required: true

  interrupts:
    required: true

  resets:
    required: true

  clocks:
    required: true

  channels:
    type: int
    description: Number of channels
    required: true

  "#io-channel-cells":
    const: 1

  vref-internal-mv:
    type: int
    description: Reference voltage in millivolts
    default: 3000

io-channel-cells:
  - input
```

## dts/bindings/can/nuvoton,numaker2-can.yaml
```yaml
# Copyright (c) 2023 Nuvoton Technology Corporation
# SPDX-License-Identifier: Apache-2.0

description: Nuvoton NuMaker CAN controller, using Bosch M_CAN IP

compatible: "nuvoton,numaker2-can"

include: ["bosch,m_can-base.yaml", reset-device.yaml, pinctrl-device.yaml]

properties:
  reg:
    required: true

  interrupts:
    required: true

  resets:
    required: true

  clocks:
    required: true
```

## dts/bindings/flash_controller/nuvoton,numaker2-fmc.yaml
```yaml
description: Nuvoton NuMaker Flash Controller

compatible: "nuvoton,numaker2-fmc"

include: flash-controller.yaml

properties:
  reg:
    required: true
```

## dts/bindings/input/analog.yaml
```yaml
# Copyright 2023 Google LLC
# SPDX-License-Identifier: Apache-2.0

description: |
  ADC based analog input device

  Implement an input device generating input events by periodically
  reading from some ADC channels.
  Each input has a resistor divider r1_top and r1_bottom.

  Example configuration:

  #include <zephyr/dt-bindings/input/input-event-codes.h>

  analog_input {
          compatible = "analog-input";
          poll-period-ms = <32>;
          // Must be sorted by increasing ADC channel number
          io-channels = <&adc 0> <&adc 1>;
          in1 {
                  index = <0>;
                  id = <1>;
                  r_top = <1100>;
                  r_bottom = <200>;
                  // zephyr,axis = <INPUT_ABS_X>;
          };
  };

compatible: "analog-input"

include: base.yaml

properties:
  poll-period-ms:
    type: int
    default: 32
    description: |
      How often to get new ADC samples for the various configured axes in
      milliseconds. Defaults to 32ms if unspecified.

child-binding:
  properties:
    # TODO: Remove it!
    io-channels:
      type: phandle-array
      required: true
      description: |
        ADC IO channel to use.
    id:
      type: int
      required: true
      description: |
        ADC IO channel id in buffer.
        This is not a ADC channel number, but a index in the io-channels property.

    r_top:
      type: int
      default: 1000
      description: |
        Resistance of the top resistor in the voltage divider.

    r_bottom:
      type: int
      default: 1000
      description: |
        Resistance of the bottom resistor in the voltage divider.

    # zephyr,axis:
    #   type: int
    #   required: true
    #   description: |
    #     The input code for the axis to report for the device, typically any of
    #     INPUT_ABS_*.
```

## dts/bindings/modem/simcom,a7682e.yaml
```yaml
description: SIMCOM A7682E GSM modem

compatible: "simcom,a7682e"


properties:
    label:
      required: true
      type: string
      description: Human readable string describing the device (used as device_get_binding() argument)

    status-gpios:
      type: phandle-array
      required: true
      description: |
        STATUS signal

    dtr-gpios:
      type: phandle-array
      required: true
      description: |
        DTR signal

    pwrkey-gpios:
      type: phandle-array
      required: true
      description: |
        PWRKEY signal

    power-gpios:
      type: phandle-array
      required: true
      description: |
        POWER signal
```

## soc/nuvoton/numaker/Kconfig
```kconfig
# Copyright (c) 2023 Nuvoton Technology Corporation.
#
# SPDX-License-Identifier: Apache-2.0


config SOC_FAMILY_NUMAKER
	# select PLATFORM_SPECIFIC_INIT
	select SOC_RESET_HOOK
	bool

if SOC_FAMILY_NUMAKER

config SOC_FAMILY
	string
	default "nuvoton_numaker"

rsource "*/Kconfig.soc"

endif # SOC_FAMILY_NUMAKER
```
